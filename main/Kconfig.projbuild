## main/Kconfig.projbuild
```kconfig
menu "App Defaults (preseed NVS on first boot)"
config APP_PRESEED_ENABLE
    bool "Preseed from sdkconfig defaults"
    default y

config APP_DEFAULT_ADMIN_USER
    string "Default admin username"
    default "admin"

config APP_DEFAULT_ADMIN_PASS
    string "Default admin password"
    default "changeme"

config APP_DEFAULT_ETH_IP
    string "Default Ethernet static IP"
    default "192.168.1.50"

config APP_DEFAULT_ETH_MASK
    string "Default Ethernet netmask"
    default "255.255.255.0"

config APP_DEFAULT_ETH_GW
    string "Default Ethernet gateway"
    default "192.168.1.1"

config APP_DEFAULT_AP_SSID
    string "Default AP SSID"
    default "Device-XXXX"

config APP_DEFAULT_AP_PASS
    string "Default AP password"
    default "setup-1234"

config APP_DEFAULT_STA_SSID
    string "Default STA SSID"
    default ""

config APP_DEFAULT_STA_PASS
    string "Default STA password"
    default ""
endmenu
```

## sdkconfig.defaults
```kconfig
CONFIG_IDF_TARGET="esp32"
CONFIG_ETH_USE_SPI_ETHERNET=y
CONFIG_ETH_SPI_ETHERNET_W5500=y
CONFIG_ETH_PHY_W5500=y
CONFIG_SPI_MASTER_ISR_IN_IRAM=y
CONFIG_HTTPD_MAX_REQ_HDR_LEN=2048
CONFIG_HTTPD_PURGE_BUF_LEN=32
CONFIG_ESP_WIFI_SSID="Device-XXXX"
CONFIG_ESP_WIFI_PASSWORD="setup-1234"
CONFIG_ESP_WIFI_AP_CHANNEL=6
CONFIG_ESP_WIFI_AP_MAX_STA_CONN=4
CONFIG_ESP_WIFI_SLP_IRAM_OPT=y
CONFIG_NVS_ENCRYPTION=n
CONFIG_MDNS_MAX_SERVICES=3
CONFIG_LOG_DEFAULT_LEVEL_INFO=y
```
